includes
{
  #include "..\\common\\CAPL_COMMON.cin"
}

variables
{
  msTimer tDoorFlCycle;
  int gDoorControlCmd;
  int gDriveState;
  int gDkeyAccessState;
  int gKeyPresence;
  int gImmobilizerState;
  int gKeyAuthState;
  dword gDoorCtrlRxMs;
  dword gVehicleRxMs;
  dword gDkeyRxMs;
  dword gImmoRxMs;
  int gLastDoorCtrlInputStale;
  int gLastVehicleInputStale;
  int gLastDkeyInputStale;
  int gLastImmoInputStale;
  int gLastLockState;
  int gLastOpenState;
  int gLastWindowPos;
}

void traceDoorFlInputHealth(int doorCtrlInputStale,
                            int vehicleInputStale,
                            int dkeyInputStale,
                            int immoInputStale)
{
  if (doorCtrlInputStale != gLastDoorCtrlInputStale)
  {
    if (doorCtrlInputStale == 1)
    {
      write("[DOOR_FL] door-control input stale");
    }
    else
    {
      write("[DOOR_FL] door-control input restored");
    }
    gLastDoorCtrlInputStale = doorCtrlInputStale;
  }

  if (vehicleInputStale != gLastVehicleInputStale)
  {
    if (vehicleInputStale == 1)
    {
      write("[DOOR_FL] vehicle input stale");
    }
    else
    {
      write("[DOOR_FL] vehicle input restored");
    }
    gLastVehicleInputStale = vehicleInputStale;
  }

  if (dkeyInputStale != gLastDkeyInputStale)
  {
    if (dkeyInputStale == 1)
    {
      write("[DOOR_FL] digital-key input stale");
    }
    else
    {
      write("[DOOR_FL] digital-key input restored");
    }
    gLastDkeyInputStale = dkeyInputStale;
  }

  if (immoInputStale != gLastImmoInputStale)
  {
    if (immoInputStale == 1)
    {
      write("[DOOR_FL] immobilizer input stale");
    }
    else
    {
      write("[DOOR_FL] immobilizer input restored");
    }
    gLastImmoInputStale = immoInputStale;
  }
}

on start
{
  gDoorControlCmd = 0;
  gDriveState = 0;
  gDkeyAccessState = 0;
  gKeyPresence = 0;
  gImmobilizerState = 1;
  gKeyAuthState = 0;
  gDoorCtrlRxMs = 0;
  gVehicleRxMs = 0;
  gDkeyRxMs = 0;
  gImmoRxMs = 0;
  gLastDoorCtrlInputStale = 0;
  gLastVehicleInputStale = 0;
  gLastDkeyInputStale = 0;
  gLastImmoInputStale = 0;
  gLastLockState = -1;
  gLastOpenState = -1;
  gLastWindowPos = -1;
  setTimer(tDoorFlCycle, 100);
  write("[DOOR_FL] start");
}

on message frmDoorControlMsg
{
  gDoorControlCmd = clampRange((int)this.DoorControlCmd, 0, 3);
  gDoorCtrlRxMs = getSimulationTimeMs();
}

on message frmVehicleStateCanMsg
{
  gDriveState = clampRange((int)this.gDriveState, 0, 3);
  gVehicleRxMs = getSimulationTimeMs();
}

on message frmDigitalKeyStateMsg
{
  gDkeyAccessState = clampRange((int)this.VehicleAccessState, 0, 7);
  gKeyPresence = clampRange((int)this.KeyPresence, 0, 1);
  gDkeyRxMs = getSimulationTimeMs();
}

on message frmImmobilizerStateMsg
{
  gImmobilizerState = clampRange((int)this.ImmobilizerState, 0, 3);
  gKeyAuthState = clampRange((int)this.KeyAuthState, 0, 3);
  gImmoRxMs = getSimulationTimeMs();
}

on timer tDoorFlCycle
{
  message frmDoorFlStateMsg mDoor;
  int doorCtrlInputStale;
  int vehicleInputStale;
  int dkeyInputStale;
  int immoInputStale;
  int driveState;
  int accessAuthorized;
  int openRequest;
  int lockState;
  int openState;
  int windowPos;
  int windowCmd;
  int manualMode;
  int manualLockCmd;
  int manualOpenCmd;

  manualMode = (((int)@Test::scenarioActiveId) == 0) ? 1 : 0;
  doorCtrlInputStale = (ethIsRecentTick(gDoorCtrlRxMs, 300) == 1) ? 0 : 1;
  vehicleInputStale = (ethIsRecentTick(gVehicleRxMs, 300) == 1) ? 0 : 1;
  dkeyInputStale = (ethIsRecentTick(gDkeyRxMs, 300) == 1) ? 0 : 1;
  immoInputStale = (ethIsRecentTick(gImmoRxMs, 300) == 1) ? 0 : 1;
  if (manualMode == 1)
  {
    vehicleInputStale = 0;
  }
  traceDoorFlInputHealth(doorCtrlInputStale, vehicleInputStale, dkeyInputStale, immoInputStale);

  if (manualMode == 1)
  {
    driveState = clampRange((int)@Chassis::driveState, 0, 3);
  }
  else
  {
    driveState = gDriveState;
  }
  if (manualMode != 1 && vehicleInputStale == 1)
  {
    driveState = 3;
  }

  accessAuthorized = 0;
  if (driveState == 0)
  {
    if (dkeyInputStale == 0 &&
        gKeyPresence == 1 &&
        gDkeyAccessState >= 1)
    {
      accessAuthorized = 1;
    }
    if (immoInputStale == 0 &&
        gImmobilizerState >= 1 &&
        gKeyAuthState >= 1)
    {
      accessAuthorized = 1;
    }
  }

  openRequest = 0;
  if (doorCtrlInputStale == 0 && gDoorControlCmd > 0)
  {
    openRequest = 1;
  }
  manualLockCmd = 0;
  manualOpenCmd = 0;

  lockState = 1;
  openState = 0;
  windowPos = clampRange((int)@Body::windowPos, 0, 90);
  if (manualMode == 1)
  {
    manualLockCmd = (clampRange((int)@Cmd::doorLockCmd, 0, 2) == 1) ? 0 : 1;
    manualOpenCmd = (clampRange((int)@Cmd::doorOpenCmd, 0, 2) == 1) ? 1 : 0;
    windowCmd = clampRange((int)@Cmd::windowCmd, 0, 2);
    if (windowCmd == 1)
    {
      windowPos = windowPos - 10;
      if (windowPos < 0) windowPos = 0;
    }
    else if (windowCmd == 2)
    {
      windowPos = windowPos + 10;
      if (windowPos > 90) windowPos = 90;
    }
  }
  else
  {
    manualLockCmd = clampRange((int)@Body::doorLockCmd, 0, 1);
    manualOpenCmd = clampRange((int)@Body::doorOpenCmd, 0, 1);
  }
  if (manualMode == 1)
  {
    lockState = (manualLockCmd > 0) ? 1 : 0;
    if (manualOpenCmd > 0 && driveState == 0 && lockState == 0)
    {
      openState = 1;
      if (windowPos < 20)
      {
        windowPos = 20;
      }
    }
  }
  else if (accessAuthorized == 1)
  {
    lockState = 0;
    if (openRequest == 1)
    {
      openState = 1;
      if (windowPos < 20)
      {
        windowPos = 20;
      }
    }
  }

  @Body::windowPos = clampRange(windowPos, 0, 90);
  mDoor.DoorFlLockState = clampRange(lockState, 0, 3);
  mDoor.DoorFlOpenState = clampRange(openState, 0, 1);
  mDoor.DoorFlWindowPos = clampRange(windowPos, 0, 90);
  output(mDoor);

  if (mDoor.DoorFlLockState != gLastLockState ||
      mDoor.DoorFlOpenState != gLastOpenState ||
      mDoor.DoorFlWindowPos != gLastWindowPos)
  {
    write("[DOOR_FL] lock=%d open=%d win=%d cmd=%d drive=%d auth=%d",
          mDoor.DoorFlLockState,
          mDoor.DoorFlOpenState,
          mDoor.DoorFlWindowPos,
          (manualMode == 1) ? manualOpenCmd : gDoorControlCmd,
          driveState,
          accessAuthorized);
    gLastLockState = mDoor.DoorFlLockState;
    gLastOpenState = mDoor.DoorFlOpenState;
    gLastWindowPos = mDoor.DoorFlWindowPos;
  }

  setTimer(tDoorFlCycle, 100);
}

on stopMeasurement
{
  cancelTimer(tDoorFlCycle);
}

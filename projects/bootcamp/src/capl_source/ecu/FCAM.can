includes
{
  #include "..\\common\\CAPL_COMMON.cin"
}

variables
{
  msTimer tFcamCycle;
  int gObjectTrackValid;
  int gObjectConfidence;
  int gNavRouteClass;
  dword gObjectInputRxMs;
  dword gNavRxMs;
  int gWarningPathStatus;
  int gE2eHealthState;
  int gFailSafeMode;
  dword gFailSafeRxMs;
  int gLastObjectInputStale;
  int gLastNavInputStale;
  int gLastHealth;
  int gLastObjectDetected;
  int gLastLaneModelValid;
  int gLastConfidence;
  int gLastPathReady;
}

int fcamPathReady()
{
  if (gFailSafeRxMs == 0)
  {
    return 1;
  }
  if (ethIsRecentTick(gFailSafeRxMs, 300) == 0)
  {
    return (gWarningPathStatus < 2 && gE2eHealthState > 0 && gFailSafeMode < 2) ? 1 : 0;
  }
  if (gWarningPathStatus >= 2 || gE2eHealthState == 0 || gFailSafeMode >= 2)
  {
    return 0;
  }
  return 1;
}

void traceFcamInputHealth(int objectInputStale, int navInputStale)
{
  if (objectInputStale != gLastObjectInputStale)
  {
    if (objectInputStale == 1)
    {
      write("[FCAM] object input stale");
    }
    else
    {
      write("[FCAM] object input restored");
    }
    gLastObjectInputStale = objectInputStale;
  }

  if (navInputStale != gLastNavInputStale)
  {
    if (navInputStale == 1)
    {
      write("[FCAM] nav input stale");
    }
    else
    {
      write("[FCAM] nav input restored");
    }
    gLastNavInputStale = navInputStale;
  }
}

int calcLaneModelValid(int navRouteClass, int navInputStale, int pathReady)
{
  if (pathReady == 1 &&
      navInputStale == 0 &&
      (navRouteClass == 2 || navRouteClass == 3))
  {
    return 1;
  }
  return 0;
}

void publishFcamState()
{
  message frmFcamStateMsg mFcam;
  int objectInputStale;
  int navInputStale;
  int objectTrackValid;
  int objectConfidence;
  int navRouteClass;
  int health;
  int objectDetected;
  int laneModelValid;
  int pathReady;

  objectInputStale = (ethIsRecentTick(gObjectInputRxMs, 300) == 1) ? 0 : 1;
  navInputStale = (ethIsRecentTick(gNavRxMs, 300) == 1) ? 0 : 1;
  traceFcamInputHealth(objectInputStale, navInputStale);

  objectTrackValid = gObjectTrackValid;
  objectConfidence = gObjectConfidence;
  navRouteClass = gNavRouteClass;
  pathReady = fcamPathReady();

  if (objectInputStale == 1)
  {
    objectTrackValid = 0;
    objectConfidence = 0;
  }
  if (pathReady == 0)
  {
    navRouteClass = 0;
  }

  objectDetected = clampRange(objectTrackValid, 0, 1);
  laneModelValid = calcLaneModelValid(navRouteClass, navInputStale, pathReady);

  if (pathReady == 0 || objectInputStale == 1)
  {
    health = 0;
  }
  else if (navInputStale == 1)
  {
    health = 1;
  }
  else
  {
    health = 2;
  }

  mFcam.CameraHealth = clampRange(health, 0, 3);
  mFcam.ObjectDetected = objectDetected;
  mFcam.LaneModelValid = laneModelValid;
  mFcam.Confidence = clampRange(objectConfidence, 0, 100);
  output(mFcam);

  if (pathReady != gLastPathReady ||
      health != gLastHealth ||
      objectDetected != gLastObjectDetected ||
      laneModelValid != gLastLaneModelValid ||
      objectConfidence != gLastConfidence)
  {
    write("[FCAM] path=%d health=%d obj=%d lane=%d conf=%d zone=%d",
          pathReady,
          health,
          objectDetected,
          laneModelValid,
          objectConfidence,
          navRouteClass);
    gLastPathReady = pathReady;
    gLastHealth = health;
    gLastObjectDetected = objectDetected;
    gLastLaneModelValid = laneModelValid;
    gLastConfidence = objectConfidence;
  }
}

on start
{
  gObjectTrackValid = 0;
  gObjectConfidence = 0;
  gNavRouteClass = 0;
  gObjectInputRxMs = 0;
  gNavRxMs = 0;
  gWarningPathStatus = 1;
  gE2eHealthState = 1;
  gFailSafeMode = 0;
  gFailSafeRxMs = 0;
  gLastObjectInputStale = 0;
  gLastNavInputStale = 0;
  gLastPathReady = -1;
  gLastHealth = -1;
  gLastObjectDetected = -1;
  gLastLaneModelValid = -1;
  gLastConfidence = -1;
  setTimer(tFcamCycle, 100);
  write("[FCAM] start");
}

on timer tFcamCycle
{
  publishFcamState();
  setTimer(tFcamCycle, 100);
}

on message frmNavModuleStateMsg
{
  gNavRouteClass = clampRange((int)this.NavRouteClass, 0, 3);
  gNavRxMs = getSimulationTimeMs();
}

on message frmFcamInputMsg
{
  gObjectTrackValid = clampRange((int)this.ObjectTrackValid, 0, 1);
  gObjectConfidence = clampRange((int)this.Confidence, 0, 100);
  gObjectInputRxMs = getSimulationTimeMs();
}

on message frmAdasDomainStateMsg
{
  gWarningPathStatus = clampRange((int)this.WarningPathStatus, 0, 2);
  gE2eHealthState = clampRange((int)this.E2eHealthState, 0, 2);
  gFailSafeMode = clampRange((int)this.FailSafeMode, 0, 2);
  gFailSafeRxMs = getSimulationTimeMs();
}

on stopMeasurement
{
  cancelTimer(tFcamCycle);
}

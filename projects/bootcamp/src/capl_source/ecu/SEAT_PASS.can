includes
{
  #include "..\\common\\CAPL_COMMON.cin"
}

variables
{
  msTimer tSeatPassCycle;
  int gSeatPos;
  int gSeatHeatLvl;
  int gSeatVentLvl;
  int gPassengerSeatCmd;
  int gDriveState;
  dword gSeatCtrlRxMs;
  dword gVehicleRxMs;
  int gLastSeatCtrlInputStale;
  int gLastVehicleInputStale;
  int gLastPos;
  int gLastHeat;
  int gLastVent;
}

void traceSeatPassInputHealth(int seatCtrlInputStale, int vehicleInputStale)
{
  if (seatCtrlInputStale != gLastSeatCtrlInputStale)
  {
    if (seatCtrlInputStale == 1)
    {
      write("[SEAT_PASS] seat-control input stale");
    }
    else
    {
      write("[SEAT_PASS] seat-control input restored");
    }
    gLastSeatCtrlInputStale = seatCtrlInputStale;
  }

  if (vehicleInputStale != gLastVehicleInputStale)
  {
    if (vehicleInputStale == 1)
    {
      write("[SEAT_PASS] vehicle input stale");
    }
    else
    {
      write("[SEAT_PASS] vehicle input restored");
    }
    gLastVehicleInputStale = vehicleInputStale;
  }
}

int applySeatDelta(int currentPos, int seatCmd)
{
  if (seatCmd == 1)
  {
    return clampRange(currentPos + 5, 0, 255);
  }
  if (seatCmd == 2)
  {
    return clampRange(currentPos - 5, 0, 255);
  }
  return clampRange(currentPos, 0, 255);
}

on start
{
  gSeatPos = 0;
  gSeatHeatLvl = 0;
  gSeatVentLvl = 0;
  gPassengerSeatCmd = 0;
  gDriveState = 0;
  gSeatCtrlRxMs = 0;
  gVehicleRxMs = 0;
  gLastSeatCtrlInputStale = 0;
  gLastVehicleInputStale = 0;
  gLastPos = -1;
  gLastHeat = -1;
  gLastVent = -1;
  setTimer(tSeatPassCycle, 100);
  write("[SEAT_PASS] start");
}

on message frmSeatControlMsg
{
  gPassengerSeatCmd = clampRange((int)this.PassengerSeatCmd, 0, 7);
  gSeatHeatLvl = clampRange((int)this.SeatHeatLevel, 0, 15);
  gSeatVentLvl = clampRange((int)this.SeatVentLevel, 0, 15);
  gSeatCtrlRxMs = getSimulationTimeMs();
}

on message frmVehicleStateCanMsg
{
  gDriveState = clampRange((int)this.gDriveState, 0, 3);
  gVehicleRxMs = getSimulationTimeMs();
}

on timer tSeatPassCycle
{
  message frmSeatPassStateMsg mSeat;
  int seatCtrlInputStale;
  int vehicleInputStale;
  int seatCmd;
  int driveState;
  int pos;
  int heat;
  int vent;

  seatCtrlInputStale = (ethIsRecentTick(gSeatCtrlRxMs, 300) == 1) ? 0 : 1;
  vehicleInputStale = (ethIsRecentTick(gVehicleRxMs, 300) == 1) ? 0 : 1;
  traceSeatPassInputHealth(seatCtrlInputStale, vehicleInputStale);

  seatCmd = gPassengerSeatCmd;
  driveState = gDriveState;
  heat = gSeatHeatLvl;
  vent = gSeatVentLvl;
  if (seatCtrlInputStale == 1)
  {
    seatCmd = 0;
    heat = 0;
    vent = 0;
  }
  if (vehicleInputStale == 1)
  {
    driveState = 3;
  }

  pos = gSeatPos;
  if (driveState == 0)
  {
    pos = applySeatDelta(pos, seatCmd);
  }
  gSeatPos = pos;

  mSeat.SeatPassPos = clampRange(pos, 0, 255);
  mSeat.SeatPassHeatLvl = clampRange(heat, 0, 15);
  mSeat.SeatPassVentLvl = clampRange(vent, 0, 15);
  output(mSeat);

  if (mSeat.SeatPassPos != gLastPos ||
      mSeat.SeatPassHeatLvl != gLastHeat ||
      mSeat.SeatPassVentLvl != gLastVent)
  {
    write("[SEAT_PASS] pos=%d heat=%d vent=%d cmd=%d drive=%d",
          mSeat.SeatPassPos,
          mSeat.SeatPassHeatLvl,
          mSeat.SeatPassVentLvl,
          seatCmd,
          driveState);
    gLastPos = mSeat.SeatPassPos;
    gLastHeat = mSeat.SeatPassHeatLvl;
    gLastVent = mSeat.SeatPassVentLvl;
  }

  setTimer(tSeatPassCycle, 100);
}

on stopMeasurement
{
  cancelTimer(tSeatPassCycle);
}

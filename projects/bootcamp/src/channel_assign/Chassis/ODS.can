/*@!Encoding:949*/
includes
{
  #include "..\\common\\CAPL_COMMON.cin"
}

variables
{
  msTimer tOdsCycle;
  int gPassengerSeatBelt;
  int gPassengerSeatPos;
  dword gSeatBeltRxMs;
  dword gSeatStateRxMs;
  int gLastSeatBeltInputStale;
  int gLastSeatStateInputStale;
  int gLastDetected;
  int gLastWeightClass;
  int gLastSuppress;
  int gLastChildSeat;
}

void traceOdsInputHealth(int seatBeltInputStale, int seatStateInputStale)
{
  if (seatBeltInputStale != gLastSeatBeltInputStale)
  {
    if (seatBeltInputStale == 1)
    {
      write("[ODS] seat-belt input stale");
    }
    else
    {
      write("[ODS] seat-belt input restored");
    }
    gLastSeatBeltInputStale = seatBeltInputStale;
  }

  if (seatStateInputStale != gLastSeatStateInputStale)
  {
    if (seatStateInputStale == 1)
    {
      write("[ODS] seat-state input stale");
    }
    else
    {
      write("[ODS] seat-state input restored");
    }
    gLastSeatStateInputStale = seatStateInputStale;
  }
}

on start
{
  gPassengerSeatBelt = 1;
  gPassengerSeatPos = 118;
  gSeatBeltRxMs = 0;
  gSeatStateRxMs = 0;
  gLastSeatBeltInputStale = 0;
  gLastSeatStateInputStale = 0;
  gLastDetected = -1;
  gLastWeightClass = -1;
  gLastSuppress = -1;
  gLastChildSeat = -1;
  setTimer(tOdsCycle, 100);
  write("[ODS] start");
}

on message frmSeatBeltStateMsg
{
  gPassengerSeatBelt = clampRange((int)this.PassengerSeatBelt, 0, 1);
  gSeatBeltRxMs = getSimulationTimeMs();
}

on message frmSeatStateMsg
{
  gPassengerSeatPos = clampRange((int)this.PassengerSeatPos, 0, 255);
  gSeatStateRxMs = getSimulationTimeMs();
}

on timer tOdsCycle
{
  message frmOdsStateMsg mOds;
  int seatBeltInputStale;
  int seatStateInputStale;
  int passengerSeatBelt;
  int passengerSeatPos;
  int occupantDetected;
  int weightClass;
  int airbagSuppress;
  int childSeatDetected;

  seatBeltInputStale = (ethIsRecentTick(gSeatBeltRxMs, 300) == 1) ? 0 : 1;
  seatStateInputStale = (ethIsRecentTick(gSeatStateRxMs, 300) == 1) ? 0 : 1;
  traceOdsInputHealth(seatBeltInputStale, seatStateInputStale);

  passengerSeatBelt = gPassengerSeatBelt;
  passengerSeatPos = gPassengerSeatPos;
  if (seatBeltInputStale == 1)
  {
    passengerSeatBelt = 1;
  }
  if (seatStateInputStale == 1)
  {
    passengerSeatPos = 0;
  }

  occupantDetected = (passengerSeatPos > 20) ? 1 : 0;
  childSeatDetected = (occupantDetected == 1 && passengerSeatBelt == 0 && passengerSeatPos < 80) ? 1 : 0;
  if (occupantDetected == 0)
  {
    weightClass = 0;
  }
  else if (childSeatDetected == 1)
  {
    weightClass = 1;
  }
  else if (passengerSeatPos < 140)
  {
    weightClass = 2;
  }
  else
  {
    weightClass = 3;
  }
  airbagSuppress = (childSeatDetected == 1 || occupantDetected == 0) ? 1 : 0;

  mOds.OccupantDetected = occupantDetected;
  mOds.WeightClass = clampRange(weightClass, 0, 7);
  mOds.AirbagSuppress = airbagSuppress;
  mOds.ChildSeatDetected = childSeatDetected;
  output(mOds);

  if (mOds.OccupantDetected != gLastDetected ||
      mOds.WeightClass != gLastWeightClass ||
      mOds.AirbagSuppress != gLastSuppress ||
      mOds.ChildSeatDetected != gLastChildSeat)
  {
    write("[ODS] occ=%d class=%d suppress=%d child=%d pos=%d",
          mOds.OccupantDetected,
          mOds.WeightClass,
          mOds.AirbagSuppress,
          mOds.ChildSeatDetected,
          passengerSeatPos);
    gLastDetected = mOds.OccupantDetected;
    gLastWeightClass = mOds.WeightClass;
    gLastSuppress = mOds.AirbagSuppress;
    gLastChildSeat = mOds.ChildSeatDetected;
  }

  setTimer(tOdsCycle, 100);
}

on stopMeasurement
{
  cancelTimer(tOdsCycle);
}

includes
{
  #include "..\\common\\CAPL_COMMON.cin"
}

variables
{
  msTimer tEscCycle;
  int gBrakePedal;
  int gSpeedNorm;
  int gDriveState;
  int gSteeringInput;
  int gChassisAliveCnt;
  int gAebStopReq;
  int gAebDecelProfile;
  int gAebDomainHealth;
  dword gVehicleStateRxMs;
  dword gSteeringRxMs;
  dword gPedalRxMs;
  dword gAebRxMs;
  int gLastVehicleStateInputStale;
  int gLastSteeringInputStale;
  int gLastPedalInputStale;
  int gLastAebInputStale;
  int gLastBrakePedal;
  int gLastAssistReq;
}

int deriveManualSteeringInputFromAngle(int steeringAngle)
{
  steeringAngle = clampRange(steeringAngle, 0, 138);
  if (steeringAngle <= 54 || steeringAngle >= 84)
  {
    return 1;
  }
  return 0;
}

int mapSignedSteeringCmdToLegacyAngle(int steeringAngleCmd)
{
  long scaledAngle;

  steeringAngleCmd = clampRange(steeringAngleCmd, -540, 540);
  scaledAngle = ((long)(steeringAngleCmd + 540) * 138) / 1080;
  return clampRange((int)scaledAngle, 0, 138);
}

void traceEscInputHealth(int vehicleStateInputStale, int steeringInputStale, int pedalInputStale, int aebInputStale)
{
  if (vehicleStateInputStale != gLastVehicleStateInputStale)
  {
    if (vehicleStateInputStale == 1)
    {
      write("[ESC] vehicle-state input stale");
    }
    else
    {
      write("[ESC] vehicle-state input restored");
    }
    gLastVehicleStateInputStale = vehicleStateInputStale;
  }

  if (steeringInputStale != gLastSteeringInputStale)
  {
    if (steeringInputStale == 1)
    {
      write("[ESC] steering input stale");
    }
    else
    {
      write("[ESC] steering input restored");
    }
    gLastSteeringInputStale = steeringInputStale;
  }

  if (pedalInputStale != gLastPedalInputStale)
  {
    if (pedalInputStale == 1)
    {
      write("[ESC] pedal input stale");
    }
    else
    {
      write("[ESC] pedal input restored");
    }
    gLastPedalInputStale = pedalInputStale;
  }

  if (aebInputStale != gLastAebInputStale)
  {
    if (aebInputStale == 1)
    {
      write("[ESC] aeb input stale");
    }
    else
    {
      write("[ESC] aeb input restored");
    }
    gLastAebInputStale = aebInputStale;
  }
}

int deriveEscAssistPressureFloor(int aebStopReq, int aebDecelProfile, int aebDomainHealth)
{
  if (aebDomainHealth == 0)
  {
    return 0;
  }
  if (aebStopReq == 1)
  {
    return 55;
  }
  if (aebDecelProfile >= 3)
  {
    return 45;
  }
  if (aebDecelProfile == 2)
  {
    return 35;
  }
  if (aebDecelProfile == 1)
  {
    return 25;
  }
  return 0;
}

on start
{
  gBrakePedal = 0;
  gSpeedNorm = 0;
  gDriveState = 0;
  gSteeringInput = 0;
  gChassisAliveCnt = 0;
  gAebStopReq = 0;
  gAebDecelProfile = 0;
  gAebDomainHealth = 0;
  gVehicleStateRxMs = 0;
  gSteeringRxMs = 0;
  gPedalRxMs = 0;
  gAebRxMs = 0;
  gLastVehicleStateInputStale = 0;
  gLastSteeringInputStale = 0;
  gLastPedalInputStale = 0;
  gLastAebInputStale = 0;
  gLastBrakePedal = -1;
  gLastAssistReq = -1;
  setTimer(tEscCycle, 100);
  write("[ESC] start");
}

on message frmVehicleStateCanMsg
{
  gSpeedNorm = clampRange((int)this.gVehicleSpeed, 0, 255);
  gDriveState = clampRange((int)this.gDriveState, 0, 3);
  gVehicleStateRxMs = getSimulationTimeMs();
}

on message frmSteeringCanMsg
{
  gSteeringInput = clampRange((int)this.SteeringInput, 0, 1);
  gSteeringRxMs = getSimulationTimeMs();
}

on message frmPedalInputCanMsg
{
  gBrakePedal = clampRange((int)this.BrakePedal, 0, 100);
  gPedalRxMs = getSimulationTimeMs();
}

on message frmAebDomainStateMsg
{
  gAebStopReq = clampRange((int)this.StopReq, 0, 1);
  gAebDecelProfile = clampRange((int)this.DecelProfile, 0, 3);
  gAebDomainHealth = clampRange((int)this.DomainHealth, 0, 3);
  gAebRxMs = getSimulationTimeMs();
}

on timer tEscCycle
{
  message frmWheelSpeedMsg mWheelSpd;
  message frmYawAccelMsg mYawAccel;
  message frmBrakeStatusMsg mBrakeStatus;
  message frmChassisHealthMsg mHealth;
  message frmEscStateMsg mEsc;
  message frmBrakeTempMsg mBrakeTemp;
  message frmBrakeWearMsg mBrakeWear;
  message frmSuspensionStateMsg mSuspension;
  message frmRoadFrictionMsg mFriction;
  int vehicleStateInputStale;
  int steeringInputStale;
  int pedalInputStale;
  int aebInputStale;
  int aebStopReq;
  int aebDecelProfile;
  int aebDomainHealth;
  int decelAssistReq;
  int assistPressureFloor;
  int speedNorm;
  int driveState;
  int manualMode;
  int steeringInput;
  int appliedBrakePedal;
  int brakePressure;
  int absActive;
  int espActive;
  int absSlip;
  int yawRate;
  int latAccel;

  vehicleStateInputStale = (ethIsRecentTick(gVehicleStateRxMs, 300) == 1) ? 0 : 1;
  steeringInputStale = (ethIsRecentTick(gSteeringRxMs, 300) == 1) ? 0 : 1;
  pedalInputStale = (ethIsRecentTick(gPedalRxMs, 300) == 1) ? 0 : 1;
  aebInputStale = (ethIsRecentTick(gAebRxMs, 300) == 1) ? 0 : 1;
  traceEscInputHealth(vehicleStateInputStale, steeringInputStale, pedalInputStale, aebInputStale);

  aebStopReq = gAebStopReq;
  aebDecelProfile = gAebDecelProfile;
  aebDomainHealth = gAebDomainHealth;
  if (aebInputStale == 1)
  {
    aebStopReq = 0;
    aebDecelProfile = 0;
    aebDomainHealth = 0;
  }
  decelAssistReq = ((aebStopReq == 1 || aebDecelProfile > 0) && aebDomainHealth > 0) ? 1 : 0;
  assistPressureFloor = deriveEscAssistPressureFloor(aebStopReq, aebDecelProfile, aebDomainHealth);
  speedNorm = gSpeedNorm;
  driveState = gDriveState;
  steeringInput = gSteeringInput;
  appliedBrakePedal = gBrakePedal;
  manualMode = (((int)@Test::scenarioActiveId) == 0) ? 1 : 0;
  if (vehicleStateInputStale == 1)
  {
    speedNorm = 0;
    driveState = 0;
  }
  if (steeringInputStale == 1)
  {
    steeringInput = 0;
  }
  if (pedalInputStale == 1)
  {
    appliedBrakePedal = 0;
  }
  if (manualMode == 1)
  {
    steeringInput = deriveManualSteeringInputFromAngle(
      mapSignedSteeringCmdToLegacyAngle((int)@Cmd::steeringAngleCmd)
    );
    appliedBrakePedal = clampRange((int)@Cmd::brakePedalPct, 0, 100);
    @Chassis::brakePressure = appliedBrakePedal;
  }
  else
  {
    @Chassis::brakePressure = clampRange(appliedBrakePedal, 0, 100);
  }
  if (assistPressureFloor > 0 && appliedBrakePedal < assistPressureFloor)
  {
    appliedBrakePedal = assistPressureFloor;
    @Chassis::brakePressure = appliedBrakePedal;
  }
  @Core::brakePedalNorm = clampRange(appliedBrakePedal, 0, 100);
  brakePressure = clampRange(appliedBrakePedal * 2, 0, 255);
  absActive = ((appliedBrakePedal > 80) && (speedNorm > 10)) ? 1 : 0;
  absSlip = absActive ? clampRange(appliedBrakePedal - 80, 0, 63) : 0;
  espActive = ((appliedBrakePedal > 40) && (steeringInput == 1)) ? 1 : 0;
  yawRate = steeringInput * 15;
  latAccel = speedNorm;
  @Chassis::brakeLamp = (appliedBrakePedal > 5) ? 1 : 0;
  @Chassis::absActive = absActive;

  mWheelSpd.WheelSpdFL = speedNorm;
  mWheelSpd.WheelSpdFR = speedNorm;
  mWheelSpd.WheelSpdRL = speedNorm;
  mWheelSpd.WheelSpdRR = speedNorm;
  output(mWheelSpd);

  mYawAccel.YawRate = yawRate;
  mYawAccel.LatAccel = latAccel;
  output(mYawAccel);

  mBrakeStatus.BrakePressure = brakePressure;
  mBrakeStatus.BrakeMode = (appliedBrakePedal > 80) ? 2 : ((appliedBrakePedal > 0) ? 1 : 0);
  mBrakeStatus.AbsActive = absActive;
  mBrakeStatus.EspActive = espActive;
  output(mBrakeStatus);

  mHealth.ChassisAliveCnt = gChassisAliveCnt & 0xFF;
  mHealth.ChassisDiagState = 1;
  mHealth.ChassisFailCode = 0;
  @Diag::ChassisDiagState = mHealth.ChassisDiagState;
  @Diag::ChassisFailCode = mHealth.ChassisFailCode;
  output(mHealth);
  gChassisAliveCnt = (gChassisAliveCnt + 1) & 0xFF;

  mEsc.EscCtrlState = espActive ? 2 : 0;
  mEsc.EscIntervention = espActive ? clampRange(appliedBrakePedal - 40, 0, 63) : 0;
  mEsc.EscYawTarget = 128;
  output(mEsc);

  mBrakeTemp.BrakeTempFL = 30 + (appliedBrakePedal / 5);
  mBrakeTemp.BrakeTempFR = 30 + (appliedBrakePedal / 5);
  output(mBrakeTemp);

  mBrakeWear.BrakePadWearLvl = 10;
  output(mBrakeWear);

  if (driveState == 3 && speedNorm >= 60 && steeringInput == 0)
  {
    mSuspension.SuspensionMode = 3;
    mSuspension.SuspensionLevel = 12;
    mSuspension.DampingLevel = 40;
  }
  else
  {
    mSuspension.SuspensionMode = (driveState == 3) ? 1 : 0;
    mSuspension.SuspensionLevel = 8;
    mSuspension.DampingLevel = 12;
  }
  output(mSuspension);


  mFriction.RoadFrictionCoef = 80;
  output(mFriction);

  if (appliedBrakePedal != gLastBrakePedal || decelAssistReq != gLastAssistReq)
  {
    write("[ESC] speed=%d pedal=%d assist=%d pressure=%d abs=%d esp=%d",
          speedNorm, appliedBrakePedal, decelAssistReq, brakePressure, absActive, espActive);
    gLastBrakePedal = appliedBrakePedal;
    gLastAssistReq = decelAssistReq;
  }

  setTimer(tEscCycle, 100);
}

includes
{
  #include "..\\common\\CAPL_COMMON.cin"
}

variables
{
  msTimer tEpbCycle;
  int gBrakePressure;
  int gBrakeMode;
  int gDriveState;
  dword gBrakeStatusRxMs;
  dword gVehicleStateRxMs;
  int gLastBrakeInputStale;
  int gLastVehicleInputStale;
  int gLastState;
  int gLastWarn;
  int gLastForce;
}

void traceEpbInputHealth(int brakeInputStale, int vehicleInputStale)
{
  if (brakeInputStale != gLastBrakeInputStale)
  {
    if (brakeInputStale == 1)
    {
      write("[EPB] brake input stale");
    }
    else
    {
      write("[EPB] brake input restored");
    }
    gLastBrakeInputStale = brakeInputStale;
  }

  if (vehicleInputStale != gLastVehicleInputStale)
  {
    if (vehicleInputStale == 1)
    {
      write("[EPB] vehicle-state input stale");
    }
    else
    {
      write("[EPB] vehicle-state input restored");
    }
    gLastVehicleInputStale = vehicleInputStale;
  }
}

void publishEpbState()
{
  message frmEpbStateMsg mEpb;
  int brakePressure;
  int brakeMode;
  int driveState;
  int brakeInputStale;
  int vehicleInputStale;
  int epbState;
  int epbWarn;
  int holdForce;

  brakeInputStale = (ethIsRecentTick(gBrakeStatusRxMs, 300) == 1) ? 0 : 1;
  vehicleInputStale = (ethIsRecentTick(gVehicleStateRxMs, 300) == 1) ? 0 : 1;
  traceEpbInputHealth(brakeInputStale, vehicleInputStale);

  brakePressure = gBrakePressure;
  brakeMode = gBrakeMode;
  driveState = gDriveState;
  if (brakeInputStale == 1)
  {
    brakePressure = 0;
    brakeMode = 0;
  }
  if (vehicleInputStale == 1)
  {
    // Avoid forcing a parking hold on a lost vehicle-state feed.
    driveState = 3;
  }

  epbState = 0;
  if (driveState == 0 && brakePressure > 20)
  {
    epbState = 2;
  }
  else if (brakeMode > 0)
  {
    epbState = 1;
  }

  epbWarn = 0;
  if (brakePressure > 180)
  {
    epbWarn = 2;
  }
  else if (brakePressure > 100)
  {
    epbWarn = 1;
  }

  holdForce = 0;
  if (epbState > 0)
  {
    holdForce = clampRange(brakePressure, 0, 255);
  }

  mEpb.EpbState = clampRange(epbState, 0, 3);
  mEpb.EpbWarnLevel = clampRange(epbWarn, 0, 3);
  mEpb.EpbHoldForce = clampRange(holdForce, 0, 255);
  output(mEpb);

  if (mEpb.EpbState != gLastState ||
      mEpb.EpbWarnLevel != gLastWarn ||
      mEpb.EpbHoldForce != gLastForce)
  {
    write("[EPB] state=%d warn=%d hold=%d pressure=%d drive=%d",
          mEpb.EpbState,
          mEpb.EpbWarnLevel,
          mEpb.EpbHoldForce,
          brakePressure,
          driveState);
    gLastState = mEpb.EpbState;
    gLastWarn = mEpb.EpbWarnLevel;
    gLastForce = mEpb.EpbHoldForce;
  }
}

on start
{
  gBrakePressure = 0;
  gBrakeMode = 0;
  gDriveState = 0;
  gBrakeStatusRxMs = 0;
  gVehicleStateRxMs = 0;
  gLastBrakeInputStale = 0;
  gLastVehicleInputStale = 0;
  gLastState = -1;
  gLastWarn = -1;
  gLastForce = -1;
  setTimer(tEpbCycle, 100);
  write("[EPB] start");
}

on timer tEpbCycle
{

  publishEpbState();
  setTimer(tEpbCycle, 100);
}

on message frmBrakeStatusMsg
{
  gBrakePressure = clampRange((int)this.BrakePressure, 0, 255);
  gBrakeMode = clampRange((int)this.BrakeMode, 0, 3);
  gBrakeStatusRxMs = getSimulationTimeMs();
}

on message frmVehicleStateCanMsg
{
  gDriveState = clampRange((int)this.gDriveState, 0, 3);
  gVehicleStateRxMs = getSimulationTimeMs();
}

on stopMeasurement
{
  cancelTimer(tEpbCycle);
}

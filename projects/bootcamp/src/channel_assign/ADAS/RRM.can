includes
{
  #include "..\\common\\CAPL_COMMON.cin"
}

variables
{
  msTimer tRearRadarCycle;
  int gLeftDetected;
  int gLeftRisk;
  int gLeftMergeConflict;
  int gLeftTurnLamp;
  int gRightDetected;
  int gRightRisk;
  int gRightMergeConflict;
  int gRightTurnLamp;
  dword gLeftRadarRxMs;
  dword gRightRadarRxMs;
  int gLastLeftRadarInputStale;
  int gLastRightRadarInputStale;
  int gLastDetected;
  int gLastLaneChangeBlock;
  int gLastRisk;
  int gLastConflict;
  int gLastHealth;
}

void traceRrmInputHealth(int leftRadarInputStale, int rightRadarInputStale)
{
  if (leftRadarInputStale != gLastLeftRadarInputStale)
  {
    if (leftRadarInputStale == 1)
    {
      write("[RRM] left radar input stale");
    }
    else
    {
      write("[RRM] left radar input restored");
    }
    gLastLeftRadarInputStale = leftRadarInputStale;
  }

  if (rightRadarInputStale != gLastRightRadarInputStale)
  {
    if (rightRadarInputStale == 1)
    {
      write("[RRM] right radar input stale");
    }
    else
    {
      write("[RRM] right radar input restored");
    }
    gLastRightRadarInputStale = rightRadarInputStale;
  }
}

void publishRearRadarMasterState()
{
  message frmRearRadarMasterStateMsg mRear;
  int leftRadarInputStale;
  int rightRadarInputStale;
  int leftDetected;
  int leftRisk;
  int leftMergeConflict;
  int leftTurnLamp;
  int rightDetected;
  int rightRisk;
  int rightMergeConflict;
  int rightTurnLamp;
  int detected;
  int laneChangeBlock;
  int rearRiskLevel;
  int mergeConflict;
  int turnLampState;
  int sensorHealth;

  leftRadarInputStale = (ethIsRecentTick(gLeftRadarRxMs, 300) == 1) ? 0 : 1;
  rightRadarInputStale = (ethIsRecentTick(gRightRadarRxMs, 300) == 1) ? 0 : 1;
  traceRrmInputHealth(leftRadarInputStale, rightRadarInputStale);

  leftDetected = gLeftDetected;
  leftRisk = gLeftRisk;
  leftMergeConflict = gLeftMergeConflict;
  leftTurnLamp = gLeftTurnLamp;
  rightDetected = gRightDetected;
  rightRisk = gRightRisk;
  rightMergeConflict = gRightMergeConflict;
  rightTurnLamp = gRightTurnLamp;
  if (leftRadarInputStale == 1)
  {
    leftDetected = 0;
    leftRisk = 0;
    leftMergeConflict = 0;
    leftTurnLamp = 0;
  }
  if (rightRadarInputStale == 1)
  {
    rightDetected = 0;
    rightRisk = 0;
    rightMergeConflict = 0;
    rightTurnLamp = 0;
  }

  detected = (leftDetected == 1 || rightDetected == 1) ? 1 : 0;
  laneChangeBlock = (leftRisk >= 40 || rightRisk >= 40) ? 1 : 0;
  rearRiskLevel = (leftRisk > rightRisk) ? leftRisk : rightRisk;
  mergeConflict = (leftMergeConflict == 1 || rightMergeConflict == 1) ? 1 : 0;
  turnLampState = (leftTurnLamp != 0) ? leftTurnLamp : rightTurnLamp;

  sensorHealth = 0;
  if (detected == 1)
  {
    sensorHealth = 2;
  }
  else if (rearRiskLevel > 0)
  {
    sensorHealth = 1;
  }

  mRear.RearObjectDetected = detected;
  mRear.LaneChangeBlock = laneChangeBlock;
  mRear.RearRiskLevel = clampRange(rearRiskLevel, 0, 100);
  mRear.MergeConflict = mergeConflict;
  mRear.TurnLampState = clampRange(turnLampState, 0, 3);
  mRear.SensorHealth = clampRange(sensorHealth, 0, 3);
  output(mRear);

  if (detected != gLastDetected ||
      laneChangeBlock != gLastLaneChangeBlock ||
      rearRiskLevel != gLastRisk ||
      mergeConflict != gLastConflict ||
      sensorHealth != gLastHealth)
  {
    write("[RRM] detected=%d lcb=%d risk=%d conflict=%d lamp=%d health=%d",
          detected,
          laneChangeBlock,
          rearRiskLevel,
          mergeConflict,
          turnLampState,
          sensorHealth);
    gLastDetected = detected;
    gLastLaneChangeBlock = laneChangeBlock;
    gLastRisk = rearRiskLevel;
    gLastConflict = mergeConflict;
    gLastHealth = sensorHealth;
  }
}

on start
{
  gLeftDetected = 0;
  gLeftRisk = 0;
  gLeftMergeConflict = 0;
  gLeftTurnLamp = 0;
  gRightDetected = 0;
  gRightRisk = 0;
  gRightMergeConflict = 0;
  gRightTurnLamp = 0;
  gLeftRadarRxMs = 0;
  gRightRadarRxMs = 0;
  gLastLeftRadarInputStale = 0;
  gLastRightRadarInputStale = 0;
  gLastDetected = -1;
  gLastLaneChangeBlock = -1;
  gLastRisk = -1;
  gLastConflict = -1;
  gLastHealth = -1;
  setTimer(tRearRadarCycle, 100);
  write("[RRM] start");
}

on timer tRearRadarCycle
{
  publishRearRadarMasterState();
  setTimer(tRearRadarCycle, 100);
}

on message frmSrrRlStateMsg
{
  gLeftDetected = clampRange((int)this.SideObjectDetected, 0, 1);
  gLeftRisk = clampRange((int)this.SideRiskLevel, 0, 100);
  gLeftMergeConflict = clampRange((int)this.MergeConflict, 0, 1);
  gLeftTurnLamp = clampRange((int)this.TurnLampState, 0, 3);
  gLeftRadarRxMs = getSimulationTimeMs();
}

on message frmSrrRrStateMsg
{
  gRightDetected = clampRange((int)this.SideObjectDetected, 0, 1);
  gRightRisk = clampRange((int)this.SideRiskLevel, 0, 100);
  gRightMergeConflict = clampRange((int)this.MergeConflict, 0, 1);
  gRightTurnLamp = clampRange((int)this.TurnLampState, 0, 3);
  gRightRadarRxMs = getSimulationTimeMs();
}

on stopMeasurement
{
  cancelTimer(tRearRadarCycle);
}

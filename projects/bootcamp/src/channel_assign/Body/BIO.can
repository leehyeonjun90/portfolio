includes
{
  #include "..\\common\\CAPL_COMMON.cin"
}

variables
{
  msTimer tBiometricCycle;
  int gOccupancyState;
  int gAirQualityState;
  int gCabinAlertState;
  int gPresenceScore;
  dword gCabinSensingRxMs;
  int gLastCabinSensingInputStale;
  int gLastAuthState;
  int gLastFactorMode;
  int gLastPresenceConfidence;
}

void traceBioInputHealth(int cabinSensingInputStale)
{
  if (cabinSensingInputStale != gLastCabinSensingInputStale)
  {
    if (cabinSensingInputStale == 1)
    {
      write("[BIO] cabin-sensing input stale");
    }
    else
    {
      write("[BIO] cabin-sensing input restored");
    }
    gLastCabinSensingInputStale = cabinSensingInputStale;
  }
}

on start
{
  gOccupancyState = 0;
  gAirQualityState = 0;
  gCabinAlertState = 0;
  gPresenceScore = 0;
  gCabinSensingRxMs = 0;
  gLastCabinSensingInputStale = 0;
  gLastAuthState = -1;
  gLastFactorMode = -1;
  gLastPresenceConfidence = -1;
  setTimer(tBiometricCycle, 100);
  write("[BIO] start");
}

on message frmCabinSensingStateMsg
{
  gOccupancyState = clampRange((int)this.OccupancyState, 0, 7);
  gAirQualityState = clampRange((int)this.AirQualityState, 0, 7);
  gCabinAlertState = clampRange((int)this.CabinAlertState, 0, 3);
  gPresenceScore = clampRange((int)this.CabinPresenceScore, 0, 100);
  gCabinSensingRxMs = getSimulationTimeMs();
}

on timer tBiometricCycle
{
  message frmBiometricAuthStateMsg mAuth;
  int cabinSensingInputStale;
  int occupancyState;
  int airQualityState;
  int cabinAlertState;
  int authState;
  int authFactorMode;
  int presenceConfidence;

  cabinSensingInputStale = (ethIsRecentTick(gCabinSensingRxMs, 300) == 1) ? 0 : 1;
  traceBioInputHealth(cabinSensingInputStale);

  occupancyState = gOccupancyState;
  airQualityState = gAirQualityState;
  cabinAlertState = gCabinAlertState;
  presenceConfidence = clampRange(gPresenceScore, 0, 100);
  if (cabinSensingInputStale == 1)
  {
    occupancyState = 0;
    airQualityState = 0;
    cabinAlertState = 0;
    presenceConfidence = 0;
  }

  if (cabinAlertState >= 2)
  {
    authState = 3;
  }
  else if (occupancyState >= 2 && presenceConfidence >= 70)
  {
    authState = 2;
  }
  else if (presenceConfidence >= 40)
  {
    authState = 1;
  }
  else
  {
    authState = 0;
  }

  authFactorMode = (airQualityState >= 2) ? 2 : ((presenceConfidence >= 70) ? 1 : 0);

  mAuth.AuthState = clampRange(authState, 0, 7);
  mAuth.AuthFactorMode = clampRange(authFactorMode, 0, 3);
  mAuth.PresenceConfidence = clampRange(presenceConfidence, 0, 100);
  output(mAuth);

  if (mAuth.AuthState != gLastAuthState ||
      mAuth.AuthFactorMode != gLastFactorMode ||
      mAuth.PresenceConfidence != gLastPresenceConfidence)
  {
    write("[BIO] state=%d factor=%d confidence=%d occ=%d",
          mAuth.AuthState,
          mAuth.AuthFactorMode,
          mAuth.PresenceConfidence,
          occupancyState);
    gLastAuthState = mAuth.AuthState;
    gLastFactorMode = mAuth.AuthFactorMode;
    gLastPresenceConfidence = mAuth.PresenceConfidence;
  }

  setTimer(tBiometricCycle, 100);
}

on stopMeasurement
{
  cancelTimer(tBiometricCycle);
}

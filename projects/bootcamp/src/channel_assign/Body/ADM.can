includes
{
  #include "..\\common\\CAPL_COMMON.cin"
}

variables
{
  msTimer tAutoDoorCycle;
  int gDoorFlLockState;
  int gDoorFrLockState;
  int gDoorFlOpenState;
  int gDoorFrOpenState;
  int gDriveState;
  dword gDoorFlRxMs;
  dword gDoorFrRxMs;
  dword gVehicleRxMs;
  int gLastDoorFlInputStale;
  int gLastDoorFrInputStale;
  int gLastVehicleInputStale;
  int gLastAutoDoorState;
  int gLastAutoUnlockState;
  int gLastApproachScore;
}

void traceAdmInputHealth(int doorFlInputStale, int doorFrInputStale, int vehicleInputStale)
{
  if (doorFlInputStale != gLastDoorFlInputStale)
  {
    if (doorFlInputStale == 1)
    {
      write("[ADM] door-fl input stale");
    }
    else
    {
      write("[ADM] door-fl input restored");
    }
    gLastDoorFlInputStale = doorFlInputStale;
  }

  if (doorFrInputStale != gLastDoorFrInputStale)
  {
    if (doorFrInputStale == 1)
    {
      write("[ADM] door-fr input stale");
    }
    else
    {
      write("[ADM] door-fr input restored");
    }
    gLastDoorFrInputStale = doorFrInputStale;
  }

  if (vehicleInputStale != gLastVehicleInputStale)
  {
    if (vehicleInputStale == 1)
    {
      write("[ADM] vehicle input stale");
    }
    else
    {
      write("[ADM] vehicle input restored");
    }
    gLastVehicleInputStale = vehicleInputStale;
  }
}

on start
{
  gDoorFlLockState = 1;
  gDoorFrLockState = 1;
  gDoorFlOpenState = 0;
  gDoorFrOpenState = 0;
  gDriveState = 0;
  gDoorFlRxMs = 0;
  gDoorFrRxMs = 0;
  gVehicleRxMs = 0;
  gLastDoorFlInputStale = 0;
  gLastDoorFrInputStale = 0;
  gLastVehicleInputStale = 0;
  gLastAutoDoorState = -1;
  gLastAutoUnlockState = -1;
  gLastApproachScore = -1;
  setTimer(tAutoDoorCycle, 100);
  write("[ADM] start");
}

on message frmDoorFlStateMsg
{
  gDoorFlLockState = clampRange((int)this.DoorFlLockState, 0, 3);
  gDoorFlOpenState = clampRange((int)this.DoorFlOpenState, 0, 1);
  gDoorFlRxMs = getSimulationTimeMs();
}

on message frmDoorFrStateMsg
{
  gDoorFrLockState = clampRange((int)this.DoorFrLockState, 0, 3);
  gDoorFrOpenState = clampRange((int)this.DoorFrOpenState, 0, 1);
  gDoorFrRxMs = getSimulationTimeMs();
}

on message frmVehicleStateCanMsg
{
  gDriveState = clampRange((int)this.gDriveState, 0, 3);
  gVehicleRxMs = getSimulationTimeMs();
}

on timer tAutoDoorCycle
{
  message frmAutoDoorCtrlStateMsg mDoor;
  int driveState;
  int doorFlInputStale;
  int doorFrInputStale;
  int vehicleInputStale;
  int doorFlLockState;
  int doorFrLockState;
  int doorFlOpenState;
  int doorFrOpenState;
  int autoDoorState;
  int autoUnlockState;
  int approachScore;

  doorFlInputStale = (ethIsRecentTick(gDoorFlRxMs, 300) == 1) ? 0 : 1;
  doorFrInputStale = (ethIsRecentTick(gDoorFrRxMs, 300) == 1) ? 0 : 1;
  vehicleInputStale = (ethIsRecentTick(gVehicleRxMs, 300) == 1) ? 0 : 1;
  traceAdmInputHealth(doorFlInputStale, doorFrInputStale, vehicleInputStale);

  driveState = gDriveState;
  if (vehicleInputStale == 1)
  {
    driveState = 3;
  }

  doorFlLockState = gDoorFlLockState;
  doorFrLockState = gDoorFrLockState;
  doorFlOpenState = gDoorFlOpenState;
  doorFrOpenState = gDoorFrOpenState;
  if (doorFlInputStale == 1)
  {
    doorFlLockState = 1;
    doorFlOpenState = 0;
  }
  if (doorFrInputStale == 1)
  {
    doorFrLockState = 1;
    doorFrOpenState = 0;
  }

  autoDoorState = (driveState == 0) ? 1 : 0;
  autoUnlockState = 0;
  if (driveState == 0 && (doorFlLockState == 0 || doorFrLockState == 0))
  {
    /* Entry access should surface as unlocked/approach-ready, not as a
       separate internal-only state that downstream reviewers never use. */
    autoUnlockState = 1;
  }
  if (doorFlOpenState == 1 || doorFrOpenState == 1)
  {
    autoUnlockState = 1;
  }

  approachScore = 40;
  if (doorFlLockState == 0 || doorFrLockState == 0) approachScore += 20;
  if (doorFlOpenState == 1 || doorFrOpenState == 1) approachScore += 20;
  if (driveState == 0) approachScore += 20;
  approachScore = clampRange(approachScore, 0, 100);

  mDoor.AutoDoorState = clampRange(autoDoorState, 0, 7);
  mDoor.AutoUnlockState = clampRange(autoUnlockState, 0, 3);
  mDoor.DoorApproachScore = clampRange(approachScore, 0, 100);
  output(mDoor);

  if (mDoor.AutoDoorState != gLastAutoDoorState ||
      mDoor.AutoUnlockState != gLastAutoUnlockState ||
      mDoor.DoorApproachScore != gLastApproachScore)
  {
    write("[ADM] state=%d unlock=%d score=%d drive=%d",
          mDoor.AutoDoorState,
          mDoor.AutoUnlockState,
          mDoor.DoorApproachScore,
          driveState);
    gLastAutoDoorState = mDoor.AutoDoorState;
    gLastAutoUnlockState = mDoor.AutoUnlockState;
    gLastApproachScore = mDoor.DoorApproachScore;
  }

  setTimer(tAutoDoorCycle, 100);
}

on stopMeasurement
{
  cancelTimer(tAutoDoorCycle);
}


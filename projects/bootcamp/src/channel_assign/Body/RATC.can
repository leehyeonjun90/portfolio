includes
{
  #include "..\\common\\CAPL_COMMON.cin"
}

variables
{
  msTimer tRearClimateCycle;
  int gCabinSetTemp;
  int gBlowerLevel;
  int gVentMode;
  int gAcOn;
  dword gHvacStateRxMs;
  dword gHvacActuatorRxMs;
  int gLastHvacStateInputStale;
  int gLastHvacActuatorInputStale;
  int gLastRearTemp;
  int gLastRearBlower;
  int gLastRearVent;
  int gLastSyncMode;
}

void traceRatcInputHealth(int hvacStateInputStale, int hvacActuatorInputStale)
{
  if (hvacStateInputStale != gLastHvacStateInputStale)
  {
    if (hvacStateInputStale == 1)
    {
      write("[RATC] hvac-state input stale");
    }
    else
    {
      write("[RATC] hvac-state input restored");
    }
    gLastHvacStateInputStale = hvacStateInputStale;
  }

  if (hvacActuatorInputStale != gLastHvacActuatorInputStale)
  {
    if (hvacActuatorInputStale == 1)
    {
      write("[RATC] hvac-actuator input stale");
    }
    else
    {
      write("[RATC] hvac-actuator input restored");
    }
    gLastHvacActuatorInputStale = hvacActuatorInputStale;
  }
}

void publishRearClimateState()
{
  message frmRearClimateStateMsg mRear;
  int hvacStateInputStale;
  int hvacActuatorInputStale;
  int cabinSetTemp;
  int blowerLevel;
  int ventMode;
  int acOn;
  int rearTemp;
  int rearBlower;
  int rearVent;
  int rearSyncMode;

  hvacStateInputStale = (ethIsRecentTick(gHvacStateRxMs, 300) == 1) ? 0 : 1;
  hvacActuatorInputStale = (ethIsRecentTick(gHvacActuatorRxMs, 300) == 1) ? 0 : 1;
  traceRatcInputHealth(hvacStateInputStale, hvacActuatorInputStale);

  cabinSetTemp = gCabinSetTemp;
  blowerLevel = gBlowerLevel;
  ventMode = gVentMode;
  acOn = gAcOn;
  if (hvacStateInputStale == 1)
  {
    cabinSetTemp = 22;
    blowerLevel = 2;
    acOn = 0;
  }
  if (hvacActuatorInputStale == 1)
  {
    ventMode = 1;
  }

  rearTemp = cabinSetTemp;
  rearBlower = blowerLevel;
  rearVent = ventMode;
  rearSyncMode = 1;

  if (acOn == 1 && rearTemp < 24)
  {
    rearTemp = rearTemp + 1;
  }
  if (rearBlower > 0)
  {
    rearBlower = clampRange(rearBlower - 1, 0, 15);
  }

  mRear.RearSetTemp = clampRange(rearTemp, 0, 100);
  mRear.RearBlowerLevel = clampRange(rearBlower, 0, 15);
  mRear.RearVentMode = clampRange(rearVent, 0, 7);
  mRear.RearSyncMode = clampRange(rearSyncMode, 0, 1);
  output(mRear);

  if (mRear.RearSetTemp != gLastRearTemp ||
      mRear.RearBlowerLevel != gLastRearBlower ||
      mRear.RearVentMode != gLastRearVent ||
      mRear.RearSyncMode != gLastSyncMode)
  {
    write("[RATC] temp=%d blower=%d vent=%d sync=%d",
          mRear.RearSetTemp,
          mRear.RearBlowerLevel,
          mRear.RearVentMode,
          mRear.RearSyncMode);
    gLastRearTemp = mRear.RearSetTemp;
    gLastRearBlower = mRear.RearBlowerLevel;
    gLastRearVent = mRear.RearVentMode;
    gLastSyncMode = mRear.RearSyncMode;
  }
}

on start
{
  gCabinSetTemp = 22;
  gBlowerLevel = 2;
  gVentMode = 1;
  gAcOn = 0;
  gHvacStateRxMs = 0;
  gHvacActuatorRxMs = 0;
  gLastHvacStateInputStale = 0;
  gLastHvacActuatorInputStale = 0;
  gLastRearTemp = -1;
  gLastRearBlower = -1;
  gLastRearVent = -1;
  gLastSyncMode = -1;
  setTimer(tRearClimateCycle, 100);
  write("[RATC] start");
}

on timer tRearClimateCycle
{
  publishRearClimateState();
  setTimer(tRearClimateCycle, 100);
}

on message frmHvacStateMsg
{
  gCabinSetTemp = clampRange((int)this.CabinSetTemp, 0, 100);
  gBlowerLevel = clampRange((int)this.BlowerLevel, 0, 15);
  gAcOn = clampRange((int)this.AcCompressorOn, 0, 1);
  gHvacStateRxMs = getSimulationTimeMs();
}

on message frmHvacActuatorMsg
{
  gVentMode = clampRange((int)this.VentMode, 0, 7);
  gHvacActuatorRxMs = getSimulationTimeMs();
}

on stopMeasurement
{
  cancelTimer(tRearClimateCycle);
}

